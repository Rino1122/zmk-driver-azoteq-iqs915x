## drivers/input/Kconfig
```kconfig
menuconfig INPUT_AZOTEQ_IQS915X
    bool "Azoteq IQS9150/IQS9151 trackpads"
    default y
    depends on GPIO
    depends on I2C
    depends on INPUT
    depends on DT_HAS_AZOTEQ_IQS915X_ENABLED
    help
      Enable driver for Azoteq IQS9150/IQS9151 trackpads.

if INPUT_AZOTEQ_IQS915X

config INPUT_AZOTEQ_IQS915X_INIT_PRIORITY
    int "Azoteq IQS915x initialization priority"
    default INPUT_INIT_PRIORITY
    help
      Driver initialization priority for the IQS915x driver.
      Lower values initialize earlier.

config INPUT_AZOTEQ_IQS915X_LOG_LEVEL
    int "Log level for Azoteq IQS915x driver"
    default 3
    depends on LOG
    help
      Sets log level for IQS915x driver.
      Levels: 0 (Off), 1 (Error), 2 (Warning), 3 (Info), 4 (Debug)


endif # INPUT_AZOTEQ_IQS915X
```

## dts/bindings/input/azoteq,iqs915x-i2c.yaml
```yaml
description: |
  Sensor driver for Azoteq IQS9150/IQS9151 trackpads, using the I2C interface

compatible: "azoteq,iqs915x"

include: ["i2c-device.yaml", "azoteq,iqs915x-common.yaml"]
```
