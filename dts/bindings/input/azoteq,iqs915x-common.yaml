## dts/bindings/input/azoteq,iqs915x-common.yaml
```yaml
properties:
  profile:
    type: phandle
    required: true
    description: Board-specific initialization and coordinate calibration profile.

  rdy-gpios:
    type: phandle-array
    required: true
    description: "Data Ready (RDY) pin. IQS9150ではRDYがLOWでデータ準備完了を通知する。"

  reset-gpios:
    type: phandle-array
    description: "Reset pin (optional)"

  one-finger-tap:
    type: boolean
    description: "Enable driver-side single finger tap (left click)"

  tap-and-hold:
    type: boolean
    description: "Enable tap-and-hold drag using single tap followed by a retouch"

  tap-and-hold-release-timeout-ms:
    type: int
    description: "Delay in ms before releasing drag after finger count becomes zero"
    default: 500

  two-finger-tap:
    type: boolean
    description: "Enable driver-side two finger tap (right click)"

  scroll:
    type: boolean
    description: "Enable driver-side two-finger scroll from absolute coordinates"

  switch-xy:
    type: boolean
    description: "Swap x and y axes"

  flip-x:
    type: boolean
    description: "Invert x axis direction"

  flip-y:
    type: boolean
    description: "Invert y axis direction"

  scroll-divisor:
    type: int
    default: 2
    description: |
      Scroll sensitivity divisor applied after the driver normalizes raw
      two-finger centroid motion by the IQS915x X/Y resolution. Smaller values
      are more sensitive. Default: 2. Increase for slower scrolling.

  pointer-accel:
    type: boolean
    description: |
      Enable firmware-side pointer acceleration for single-finger cursor motion.
      This scales only the relative INPUT_REL_X/Y reports emitted by the driver.

  pointer-sensitivity-percent:
    type: int
    default: 100
    description: |
      Base pointer sensitivity percentage. 100 keeps raw absolute-coordinate
      deltas unchanged when pointer-accel is disabled.

  pointer-accel-threshold:
    type: int
    default: 8
    description: |
      Normalized 10 ms pointer speed at or below which only base sensitivity is
      applied. Speed is max(abs(dx), abs(dy)).

  pointer-accel-saturation:
    type: int
    default: 96
    description: |
      Normalized 10 ms pointer speed at or above which pointer-accel-max-percent
      is applied.

  pointer-accel-max-percent:
    type: int
    default: 180
    description: |
      Maximum pointer scale percentage used when pointer acceleration is enabled.

  scroll-inertia:
    type: boolean
    description: |
      Enable scroll inertia. When enabled, scrolling continues with momentum
      after releasing fingers and decays according to the inertia profile.

  trigger-ms:
    type: int
    default: 35
    description: |
      Delay in ms from the first zero-finger report to inertia start. Release
      must first pass the fixed 20 ms finger-count debounce, so inertia starts
      no earlier than that confirmation. This delay does not change the fixed
      100 ms velocity estimation window ending at the first zero-finger report.

  scroll-decay-factor-int:
    type: int
    default: 85
    description: |
      Scroll inertia retention percentage (0-100) over the boot-time
      scroll-report-interval-ms. Runtime output cadence changes do not change
      this reference period. Decay uses actual elapsed time.
      Higher values produce longer inertia.

  scroll-report-interval-ms:
    type: int
    default: 65
    description: |
      Interval in ms between inertia reports. Displacement is integrated over
      actual elapsed time. This boot-time value also sets the decay reference.

  scroll-inertia-initial-velocity-percent:
    type: int
    default: 100
    description: |
      Initial inertia velocity as a percentage of the 100 ms average release
      velocity. Range 100-1000: 100 uses the measured velocity directly;
      200 doubles it. This does not change manual scrolling or start detection.

  scroll-threshold-start:
    type: int
    default: 2
    description: |
      Minimum release-time average scroll velocity required to start inertia,
      in coordinate units per 10 ms. Velocity is signed displacement divided
      by elapsed time over the latest 100 ms (or the available shorter history).
      The larger absolute axis velocity is compared with this threshold.

  scroll-threshold-stop:
    type: int
    default: 0
    description: |
      Minimum decayed scroll velocity required to continue inertia,
      in coordinate units per 10 ms after applying the initial velocity multiplier.
      Inertia stops when both axes are below or equal to this value.

  three-finger-swipe:
    type: boolean
    description: |
      Enable three-finger swipe as one-shot gesture input event generated from
      multi-finger centroid motion.

  four-finger-swipe:
    type: boolean
    description: |
      Enable four-finger swipe as one-shot gesture input event generated from
      multi-finger centroid motion.

  swipe-step:
    type: int
    default: 0
    description: |
      Absolute swipe threshold in raw coordinate units. Set >0 to force a
      fixed threshold for both axes. If set to 0 (default), the driver reads
      X/Y resolutions from init-data registers 0x11E6/0x11E8 and computes one
      shared threshold from the smaller resolution by ratio
      (numerator/denominator).

  swipe-threshold-numerator:
    type: int
    default: 1
    description: |
      Numerator of the auto threshold ratio applied to the smaller X/Y
      resolution when swipe-step is 0.

  swipe-threshold-denominator:
    type: int
    default: 5
    description: |
      Denominator of the auto threshold ratio applied to the smaller X/Y
      resolution when swipe-step is 0. Default 1/5 means trigger after about
      20% movement of the smaller axis.

  swipe-direction-settle-frames:
    type: int
    default: 2
    description: |
      Number of post-baseline stable 3/4-finger frames to observe before the
      driver may lock and emit a swipe direction. This filters touch-down
      centroid noise before direction recognition.

  swipe-direction-lock-numerator:
    type: int
    default: 3
    description: |
      Numerator of the dominant-axis lock ratio for 3/4-finger swipes. A swipe
      emits only when the dominant axis is at least numerator/denominator times
      the other axis.

  swipe-direction-lock-denominator:
    type: int
    default: 2
    description: |
      Denominator of the dominant-axis lock ratio for 3/4-finger swipes.
      Default 3/2 means the dominant axis must be about 1.5x the other axis.

  report-rate-ms:
    type: int
    description: |
      Active mode sampling period in ms. Lower values = smoother cursor but
      higher power consumption. If not set, IQS9150 NVM default is used.
      Typical: 10 (100Hz default), 5 (200Hz), 2 (500Hz).

  coordinate-correction:
    type: boolean
    description: |
      Enable driver-side absolute coordinate correction using per-axis block-local
      LUTs. If unset, the driver uses raw IQS9150 absolute coordinates.

  disabled-by-default:
    type: boolean
    description: |
      Start with trackpad disabled (enter LP2 after initialization) at boot.
      Use iqs915x_set_enabled() API to enable/disable the trackpad
      at runtime, e.g. from a ZMK behavior or key binding.
```

## dts/bindings/input/azoteq,iqs915x-profile.yaml
```yaml
description: Board-specific IQS915x initialization and coordinate profile

compatible: "azoteq,iqs915x-profile"

properties:
  init-data:
    type: uint8-array
    required: true
    description: Complete IQS915x initialization byte stream.

  x-coordinate-lut-q15:
    type: array
    required: true
    description: X-axis half-block correction LUT in Q15 format.

  y-coordinate-lut-q15:
    type: array
    required: true
    description: Y-axis half-block correction LUT in Q15 format.

  x-coordinate-blocks:
    type: int
    required: true

  y-coordinate-blocks:
    type: int
    required: true
```
